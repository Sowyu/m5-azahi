/dts-v1/;
/plugin/;

/ {

	fragment@0 {
		target-path = "/soc";

		__overlay__ {

			pcie_dart0: iommu@410000000 {
				compatible = "apple,t6050-dart", "apple,t8110-dart";
				reg = <0x04 0x10000000 0x00 0x4000>;
				interrupt-parent = <0x02>;
				interrupts = <0x00 0x5f4 0x04>;
				#iommu-cells = <0x01>;
				phandle = <0x02>;
			};

			pcie0: pcie@1cb0000000 {
				compatible = "azahi,t6050-pcie";
				device_type = "pci";
				reg = <0x1c 0xb0000000 0x00 0x1000000 0x04 0x14000000 0x00 0x4000 0x04 0x10028000 0x00 0x8000 0x04 0x17010000 0x00 0x4000>;
				reg-names = "config", "rc", "port0", "phy0";
				interrupt-parent = <0x02>;
				interrupts = <0x00 0x5f3 0x04>;
				msi-controller;
				msi-parent = <&pcie0>;
				msi-ranges = <0x02 0x00 0x720 0x01 0x20>;
				iommu-map = <0x100>, <&pcie_dart0>, <0x01 0x01 0x101>, <&pcie_dart0>, <0x02 0x01 0x102>, <&pcie_dart0>, <0x03 0x01>;
				iommu-map-mask = <0xffff>;
				bus-range = <0x00 0x08>;
				#address-cells = <0x03>;
				#size-cells = <0x02>;
				ranges = <0x43000000 0x0b 0xc0000000 0x0b 0xc0000000 0x00 0x20000000 0x2000000 0x00 0x80000000 0x0b 0x80000000 0x00 0x40000000>;
				dma-coherent;
				phandle = <0x01>;

				pcie0_port0: pci@0,0 {
					device_type = "pci";
					reg = <0x00 0x00 0x00 0x00 0x00>;
					#address-cells = <0x03>;
					#size-cells = <0x02>;
					ranges;
					interrupt-controller;
					#interrupt-cells = <0x01>;
					interrupt-map-mask = <0x00 0x00 0x00 0x07>;
					interrupt-map = <0x00 0x00 0x00 0x01>, <&pcie0_port0>, <0x00 0x00 0x00 0x00 0x00 0x00 0x00 0x02>, <&pcie0_port0>, <0x00 0x00 0x00 0x01 0x00 0x00 0x00 0x03>, <&pcie0_port0>, <0x00 0x00 0x00 0x02 0x00 0x00 0x00 0x04>, <&pcie0_port0>, <0x00 0x00 0x00 0x03>;
					phandle = <0x03>;
				};
			};
		};
	};


	__local_fixups__ {

		fragment@0 {

			__overlay__ {

				pcie@1cb0000000 {
					msi-parent = <0x00>;
					iommu-map = <0x04 0x14 0x24>;

					pci@0,0 {
						interrupt-map = <0x10 0x34 0x58 0x7c>;
					};
				};
			};
		};
	};
};
